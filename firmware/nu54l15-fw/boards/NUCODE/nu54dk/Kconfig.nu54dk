## firmware/nu54l15-fw/boards/NUCODE/nu54dk/Kconfig.nu54dk
```kconfig
config BOARD_NU54DK
	select SOC_NRF54L15_CPUAPP if BOARD_NU54DK_NRF54L15_CPUAPP
	select SOC_NRF54L15_CPUFLPR if \
		BOARD_NU54DK_NRF54L15_CPUFLPR || \
		BOARD_NU54DK_NRF54L15_CPUFLPR_XIP
```

## firmware/nu54l15-fw/boards/NUCODE/nu54dk/board.yml
```yaml
board:
  name: nu54dk
  vendor: NUCODE
  socs:
  - name: nrf54l15
    variants:
    - name: xip
      cpucluster: cpuflpr
```

## firmware/nu54l15-fw/boards/NUCODE/nu54l05/Kconfig.nu54l05
```kconfig
config BOARD_NU54L05
	select SOC_NRF54L05_CPUAPP if BOARD_NU54L05_NRF54L05_CPUAPP
	select SOC_NRF54L05_CPUFLPR if \
		BOARD_NU54L05_NRF54L05_CPUFLPR || \
		BOARD_NU54L05_NRF54L05_CPUFLPR_XIP
```

## firmware/nu54l15-fw/boards/NUCODE/nu54l05/board.yml
```yaml
board:
  name: nu54l05
  vendor: NUCODE
  socs:
  - name: nrf54l05
    variants:
    - name: xip
      cpucluster: cpuflpr
```
